#include <string.h>
#include "mydefine.h"
unsigned char di_yz[8][128];
void clr_yz(void);
void disp_yz(unsigned char h,unsigned char l);
void disp_open_wil(void);
void Print_word(unsigned char *add,unsigned char h,unsigned char l,unsigned char len);	
void Print_words(unsigned char add[],unsigned char h,unsigned char l,unsigned char len);

/**************************************************************************************/
//6*8字符字模
/**************************************************************************************/
__code const INT8U FontSystem6x8[]={
//0x00,0x07,0x00,0x07,0x00,0x00,/*"""=02h*/
0x00,0x00,0x00,0x00,0x00,0x00,/*" "=00H*/
0x00,0x5F,0x00,0x00,0x00,0x00,/*"!"=01H*/
//0x00,0x07,0x00,0x07,0x00,0x00,/*"""=02h*/
0x14,0x7F,0x14,0x7F,0x14,0x00,/*"#"=03h*/
0x24,0x2A,0x7F,0x2A,0x12,0x00,/*"$"=04h*/
0x23,0x13,0x08,0x64,0x62,0x00,/*"%"=05h*/
0x36,0x49,0x55,0x22,0x50,0x00,/*"&"=06h*/
0x00,0x05,0x03,0x00,0x00,0x00,/*"'"=07h*/
0x00,0x1C,0x22,0x41,0x00,0x00,/*"("=08h*/
0x00,0x41,0x22,0x1C,0x00,0x00,/*")"=09h*/
//0x7F,0x7F,0x7F,0x7F,0x7F,0x00,  // ??=0Ah
//0x7F,0x7F,0x7F,0x7F,0x7F,0x00,  // ??=0bh
0x00,0xA0,0x60,0x00,0x00,0x00,/*","=0Ch*/
0x08,0x08,0x08,0x08,0x08,0x00,/*"-"=0Dh*/
0x00,0x60,0x60,0x00,0x00,0x00,/*"."=0Eh*/
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0x61,0x51,0x49,0x45,0x43,0x00,/*"Z"=3Ah*/
//0x00,0x7F,0x41,0x41,0x00,0x00,/*"["=3Bh*/
//0x02,0x04,0x08,0x10,0x20,0x00,/*"\"=3Ch*/
//0x00,0x41,0x41,0x7F,0x00,0x00,/*"]"=3Dh*/
0x04,0x02,0x01,0x02,0x04,0x00,/*"^"=3Eh*/
0x40,0x40,0x40,0x40,0x40,0x00,/*"_"=3Fh*/
0x01,0x02,0x04,0x00,0x00,0x00,/*"`"=40h*/
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0x02,0x01,0x02,0x04,0x02,0x00,/*"~"=5Eh*/
};

__code const unsigned char f68[] =
{
	 " !#$%&'(),-./0123456789:;<=>?@ABCDEFGhIJKLMNOPQRSTUVWXYZ^_`abcdefghijklmnopqrstuvwxyz"
};

__code const INT8U FontSystem7x7[]={
0x08,0xF8,0x88,0x88,0xC8,0x08,0x08,0x0F,
0x08,0x00,0x01,0x00,/*"F",0*/

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0x09,0x01,0x09,0x0E,/*"A",3*/
};

__code const unsigned char f77[] ={"FDMA"};

__code const INT8U Font[]= {
0x00,0x00,0x00,0x00,0x00,0x00,0x00,0x00,
0x00,0x00,0x00,0x00,0x00,0x00,0x00,0x00,
0x00,0x00,0x00,0x00,0x00,0x00,0x00,0x00,
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0x00,0x00,0x00,0x00,0x00,0x00,0x00,0x00,/*"C:\Documents and Settings\Administrator\桌面\2.BMP",0*/
};

/**************************************************************************************
//汉字字模
**************************************************************************************/
__code const INT8U FontNew16X16[] = {

0x00,0xFC,0x44,0x44,0x44,0xC4,0x04,0x3F,
0xC4,0x05,0xC6,0x64,0x00,0x00,0x18,0x07,
0x00,0x02,0x04,0x03,0x10,0x0C,0x03,0x05,
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0x04,0x04,0x04,0x00,/*"二",6*/

};


/**************************************************************************************
//汉字字模索引
**************************************************************************************/
__code const INT8U FontNew16X16_Index[] = {
  "成都无线龙通讯科技有限公司点对点实验接收的数据：频分多址道一二"
	};

void clr_yz(void)
{
	unsigned char i,j;
	for(i = 0;i<8;i++)
	    for(j = 0;j<128;j++)
	    di_yz[i][j] = 0;
}
//配点


////////////////////////////////////////////////////////////////////////////////////////////////
/*
h:显示从哪一行开始
l:显示从哪一列开始
*str ：字符串列表地址
len :显示的字串长度
type:显示类型：
  高4位为字体的大小…………高
  低4位为字体的大小…………宽


*/
/////////////////////////////////////////////////////////////////////////////////////////////////
void disp_yz_you_want(unsigned char h,unsigned char l,unsigned char *str,unsigned int len,unsigned char type)
{
  unsigned int i,j;
  unsigned temp = type&0x0f;
  unsigned cplen;
  cplen = (type&0x0f+type&0xf0)/2;
	j = len;
	void  *priont;
	for(i = 0;i< j;)
	{		
		priont = (&di_yz[h][l] + i/2);
	  memcpy((void *)priont,(void *)str, cplen);
	  i=i+ temp*2;
	}
	for(i = temp;i< j;)
	{		
		priont = (void *)(&di_yz[(h+1)][l] + i/2);
    memcpy((void *)priont,(void *)str, cplen);
    i = i+temp*2;
	}
}
void disp_open_wil(void)
{
  unsigned char temp[5] = {0x68,0xaa,'U','Y','J'};
  UartSendWord(temp,5);
  UartSendWord((void*)Font,sizeof(Font));
}

void disp_yz(unsigned char h,unsigned char l)
{
	unsigned int i,j;
	j = 72;
	void  *priont,*priont1;
	for(i = 0;i< j;)
	{		
		priont = (&di_yz[h][l] + (i/28)*14);
	  priont1 = (void *)(FontNew16X16+i);
	  memcpy((void *)priont,(void *)priont1, 14);
	  i=i+28;
	}
	for(i = 14;i< j;)
	{		
		priont = (void *)(&di_yz[(h+1)][l] + (i/28)*14);
		priont1 = (void *)(FontNew16X16+i);
    memcpy((void *)priont,(void *)priont1, 14);
    i = i+28;
	}
}
unsigned char chick(unsigned char temp)
{
	unsigned char i,j;
	j = sizeof(f68);
	for(i = 0; i<j; i++)
	{
		if(f68[i] == temp) return i;
	}
	return 1;
}

void Print_word(unsigned char *add,unsigned char h,unsigned char l,unsigned char len)
{
 unsigned int i;
 for(i = 0;i<len;i++)
 {
 	memcpy(&di_yz[h][l+i*8+1],(void *)(&FontSystem6x8[chick(*add)*6]),6);	
 	add++;
 }
}


void Print_words(unsigned char add[],unsigned char h,unsigned char l,unsigned char len)
{
  unsigned int i,j,wm,word_number,add_number;
  wm = 0;
  word_number = 0;
  add_number = 0;
  while(len)
  {
    for(wm = 0;wm <100;wm++)
    {
      if((FontNew16X16_Index[wm] == add[add_number])&&(FontNew16X16_Index[wm+1] == add[add_number+1]))
      {

        for(j = h;j<(2+h);j++)
          for(i = l;i<(l+14);i++)
          {
                di_yz[j][i] = FontNew16X16[word_number + wm*14];	
                word_number++;
          }
        word_number = 0;
        l = l+14;
        wm = 100;
      }
      else
      {
        wm += 1;
      }
    }
        len--;
        if(len>0)
        {
          wm = 0;
          add_number += 2;
        }
  }
}



